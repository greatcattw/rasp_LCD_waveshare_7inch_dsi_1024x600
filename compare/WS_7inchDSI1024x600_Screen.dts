/dts-v1/;

/ {
	compatible = "brcm,bcm2835";

	fragment@0 {
		target = < 0xffffffff >;

		__overlay__ {
			status = "okay";
			power-domains = < 0xffffffff 0x12 >;

			port {

				endpoint {
					remote-endpoint = < 0x01 >;
					phandle = < 0x02 >;
				};
			};
		};
	};

	fragment@1 {
		target = < 0xffffffff >;

		__overlay__ {
			#address-cells = < 0x01 >;
			#size-cells = < 0x00 >;
			status = "okay";
			power-domains = < 0xffffffff 0x12 >;

			WS_7inchDSI1024x600_Screen@0 {
				compatible = "WS_7inchDSI1024x600_Screen_compatible";
				label = "WS_7inchDSI1024x600_Screen";
				reg = < 0x00 >;
				Backlight_value = < 0xff >;
				phandle = < 0x03 >;

				port {

					endpoint {
						remote-endpoint = < 0x02 >;
						phandle = < 0x01 >;
					};
				};
			};
		};
	};

	__overrides__ {
		Backlight = [ 00 00 00 03 42 61 63 6b 6c 69 67 68 74 5f 76 61 6c 75 65 3a 30 00 ];
	};

	__fixups__ {
		dsi1 = "/fragment@0:target:0\0/fragment@1:target:0";
		power = "/fragment@0/__overlay__:power-domains:0\0/fragment@1/__overlay__:power-domains:0";
	};

	__local_fixups__ {

		fragment@0 {

			__overlay__ {

				port {

					endpoint {
						remote-endpoint = < 0x00 >;
					};
				};
			};
		};

		fragment@1 {

			__overlay__ {

				WS_7inchDSI1024x600_Screen@0 {

					port {

						endpoint {
							remote-endpoint = < 0x00 >;
						};
					};
				};
			};
		};

		__overrides__ {
			Backlight = < 0x00 >;
		};
	};
};
